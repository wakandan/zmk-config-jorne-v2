#include "jorne.dtsi" // The shared dtsi file is included in the overlay

/ {
    encoder_right: encoder_right {
        compatible = "alps,ec11";
        a-gpios = <&gpio1 8 (GPIO_ACTIVE_LOW | GPIO_PULL_UP)>;
        b-gpios = <&gpio0 9 (GPIO_ACTIVE_LOW | GPIO_PULL_UP)>;
        steps = <24>;
        status = "disabled";
    };
};

// Label of the kscan node in the dtsi
// col 7 is on the right most side of the board
// col 7 (right most) -> pin 21
// col 8 -> pin 20
// ...
// col 15 (left most side) -> pin 4
&default_transform { // Offset of 8 because the left side has 8 columns
    col-offset = <7>;
};

&kscan0 {
    col-gpios
        = <&pro_micro 21 GPIO_ACTIVE_HIGH>
        , <&pro_micro 20 GPIO_ACTIVE_HIGH>
        , <&pro_micro 19 GPIO_ACTIVE_HIGH>
        , <&pro_micro 18 GPIO_ACTIVE_HIGH>
        , <&pro_micro 15 GPIO_ACTIVE_HIGH>
        , <&pro_micro 14 GPIO_ACTIVE_HIGH>
        , <&pro_micro 8 GPIO_ACTIVE_HIGH>
        ;
};