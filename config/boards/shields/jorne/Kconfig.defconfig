## config/boards/shields/jorne/Kconfig.defconfig
```kconfig
if SHIELD_JORNE_LEFT

# Name must be less than 16 characters long!
config ZMK_KEYBOARD_NAME
    default "jorne"

config ZMK_SPLIT_ROLE_CENTRAL
    default y

endif

if SHIELD_JORNE_LEFT || SHIELD_JORNE_RIGHT

config ZMK_SPLIT
    default y

endif
```

## config/boards/shields/jorne/Kconfig.shield
```kconfig
# No whitespace after the comma or in your part name!
config SHIELD_JORNE_LEFT
    def_bool $(shields_list_contains,jorne_left)

# No whitespace after the comma or in your part name!
config SHIELD_JORNE_RIGHT
    def_bool $(shields_list_contains,jorne_right)
```
