#include "jorne.dtsi" // The shared dtsi file is included in the overlay

// Label of the kscan node in the dtsi
// col 0 is on the right most side of the board
// col 0 -> pin 21
// col 1 -> pin 20
// ...
&kscan0 {
    col-gpios
        = <&pro_micro 21 GPIO_ACTIVE_HIGH>
        , <&pro_micro 20 GPIO_ACTIVE_HIGH>
        , <&pro_micro 19 GPIO_ACTIVE_HIGH>
        , <&pro_micro 18 GPIO_ACTIVE_HIGH>
        , <&pro_micro 15 GPIO_ACTIVE_HIGH>
        , <&pro_micro 14 GPIO_ACTIVE_HIGH>
        , <&pro_micro 16 GPIO_ACTIVE_HIGH>
    ;
};

&encoder_left {
    status = "okay";
};