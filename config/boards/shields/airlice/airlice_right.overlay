#include "airlice.dtsi" // The shared dtsi file is included in the overlay

// Label of the kscan node in the dtsi
// col 7 is on the right most side of the board
// col 7 (right most) -> pin 21
// col 8 -> pin 20
// ...
// col 15 (left most side) -> pin 4
&kscan0 {
    col-gpios
        = <&pro_micro 21 GPIO_ACTIVE_HIGH>
        , <&pro_micro 20 GPIO_ACTIVE_HIGH>
        , <&pro_micro 19 GPIO_ACTIVE_HIGH>
        , <&pro_micro 18 GPIO_ACTIVE_HIGH>
        , <&pro_micro 15 GPIO_ACTIVE_HIGH>
        , <&pro_micro 14 GPIO_ACTIVE_HIGH>
        , <&pro_micro 16 GPIO_ACTIVE_HIGH>
        , <&pro_micro 10 GPIO_ACTIVE_HIGH>
        , <&pro_micro 3 GPIO_ACTIVE_HIGH>
        ;
};

&default_transform { // Offset of 8 because the left side has 8 columns
    col-offset = <9>;
};
